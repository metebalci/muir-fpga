// SPDX-FileCopyrightText: 2026 Mete Balci
// SPDX-License-Identifier: GPL-2.0-or-later
/*
 * The Kria KR260 as Linux sees it, with the CADR beside it.
 *
 * AN OVERLAY ON MAINLINE'S OWN KR260 TREE.  Mainline builds the board's tree
 * as the K26 starter-kit SOM's (`zynqmp-smk-k26-revA.dts`) with the KR260
 * carrier's overlay applied (`zynqmp-sck-kr-g-revB.dtso`), and Buildroot
 * builds exactly that tree, `xilinx/zynqmp-smk-k26-revA-sck-kr-g-revB`.  This
 * file is applied to it afterwards with `fdtoverlay`
 * (`board/kria-kr260/post-image.sh`), and the result,
 * zynqmp-smk-k26-revA-sck-kr-g-revB-cadr.dtb, is the tree the card carries.
 * Nothing of AMD's is copied here; nothing of the kernel's source is patched.
 *
 * WHAT IS ADDED:
 *
 *   the model, restated in AMD's own words ("ZynqMP KR260 revB", the
 *     carrier's overlay), so that the card staging can read which board's
 *     tree this is out of this file, as it reads the other boards' out of
 *     theirs;
 *   the CADR's 128 MB at 0x6000_0000, no-map, from cadr-reserved.dtsi, which
 *     says why there;
 *   the QSPI FLASH CONTROLLER TURNED OFF.  The flash holds the board's own
 *     boot firmware, two images of it, and this project never writes it.
 *     With the node on, Linux binds the controller and offers the flash as
 *     /dev/mtd*; with it off, nothing on the board can reach the flash at
 *     all, and nothing here reads it.  The DE25-Nano's tree turns its flash
 *     controller off too, for a reason of its own.
 *
 * NOTHING OF THE FABRIC IS DESCRIBED.  As on the other boards the programs
 * reach the faces through /dev/mem, so there is no node for them.  The card's
 * boot script loads the fabric with the factory U-Boot's `fpga loadb`, whose
 * load releases the fabric's isolation and resets by itself, before the
 * kernel starts.
 *
 * Every node is named by its path, `&{/...}`, because the base tree's labels
 * are not needed and a path cannot resolve to a different node.
 */

/dts-v1/;
/plugin/;

&{/} {
	model = "ZynqMP KR260 revB";
};

/include/ "cadr-reserved.dtsi"

&{/axi/spi@ff0f0000} {
	status = "disabled";
};
