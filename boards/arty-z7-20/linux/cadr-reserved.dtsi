// SPDX-FileCopyrightText: 2026 Mete Balci
// SPDX-License-Identifier: AGPL-3.0-or-later
//
// The CADR's memory, told to Linux.
//
// `rtl/plumbing/cadr_ddr_map.sv` reserves 17.125 MB of the Zynq boards' 512 MB
// for the machine: main memory's 16 MB, the display's 1 MB and the disk pack
// program's 128 KB of records, in that order.  Nothing here decides that: this
// file is the same fact in the device tree's own words, and the two have to
// move together.
//
//   RESERVED_BASE = 0x1B00_0000, RESERVED_BYTES = 0x0112_0000
//
// One node for the whole reservation rather than three for main memory, the
// display and the records.  0x0112_0000 bytes at 0x1B00_0000 is exactly what
// the map's RESERVED_BASE and RESERVED_BYTES say; sub-dividing it is a change
// to make when something claims a sub-region by phandle, and not before.
// Linux keeps 0x0000_0000-0x1AFF_FFFF and 0x1C12_0000-0x1FFF_FFFF.
//
// `no-map`, and the reason is coherency rather than tidiness.  S_AXI_HP does
// not snoop the A9 caches, so a cacheable kernel mapping of memory the fabric
// writes would go stale in a way that reads as a fabric fault --- the worst
// class of bug available here.  `no-map` keeps the region out of the kernel's
// linear map entirely, and makes a later userspace mapping uncached by
// construction.
//
// U-Boot reads this node in its own tree too, and keeps its relocation and
// what it places clear of it (`tools/reserved_check.py`, `docs/linux.md`).
//
// This is appended to the BSP's decompiled device tree --- dtc merges the two
// root definitions.

/ {
	reserved-memory {
		#address-cells = <0x01>;
		#size-cells = <0x01>;
		ranges;

		cadr@1b000000 {
			reg = <0x1b000000 0x01120000>;
			no-map;
		};
	};
};
