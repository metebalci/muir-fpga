## boards/arty-z7-20/linux/buildroot/package/cadr-chaosnet/Config.in
```kconfig
# SPDX-FileCopyrightText: 2026 Mete Balci
# SPDX-License-Identifier: AGPL-3.0-or-later
config BR2_PACKAGE_CADR_CHAOSNET
	bool "cadr-chaosnet"
	select BR2_PACKAGE_CADR_COMMON
	help
	  The Chaosnet: the program on the processing system that carries
	  packets between the CADR's Chaosnet interface in the fabric and
	  the outside world.  It is the cable the interface is plugged
	  into, and nothing above that.

	  It answers no services, because a CADR holds none.  The file and
	  time host a band calls is another machine on the network, which
	  this program reaches like any other station.

	  Chaosnet over UDP puts the cable on the board's Ethernet, so
	  that host or a bridge can be a station on it.

	  It has an init script, as cadr-disk-packs and cadr-terminal do:
	  a machine that is up wants its cable up too, and nothing is on
	  the bus while no packet is moving.
```

## boards/arty-z7-20/linux/buildroot/package/cadr-checkpoint/Config.in
```kconfig
# SPDX-FileCopyrightText: 2026 Mete Balci
# SPDX-License-Identifier: AGPL-3.0-or-later
config BR2_PACKAGE_CADR_CHECKPOINT
	bool "cadr-checkpoint"
	select BR2_PACKAGE_CADR_COMMON
	select BR2_PACKAGE_CADR_READOUT
	help
	  The checkpoint program. It reads the CADR's own memories
	  through the console's readout window and its main memory
	  through /dev/mem, and writes the whole machine as a muir
	  checkpoint. The file can then be opened in muir and resumed.

	  It digests the disk packs at the same instant and writes a
	  sidecar beside the checkpoint naming them, because a
	  checkpoint carries the blocks a run has written and never the
	  disk itself: resumed over a pack that has moved on, it
	  restores a machine into a disk it never had, and nothing in
	  muir can notice.

	  It halts the machine while it reads and starts it again
	  afterwards. It is not a daemon and has no init script: it is
	  run once, when somebody wants the machine in a file.
```

## boards/arty-z7-20/linux/buildroot/package/cadr-readout/Config.in
```kconfig
# SPDX-FileCopyrightText: 2026 Mete Balci
# SPDX-License-Identifier: AGPL-3.0-or-later
config BR2_PACKAGE_CADR_READOUT
	bool "cadr-readout"
	select BR2_PACKAGE_CADR_COMMON
	help
	  The readout: the program that prints the CADR's own memories.
	  The control store, the boot PROM, the scratchpads, the
	  pushdown buffer, the micro-stack, the dispatch memory and both
	  levels of the map are inside the fabric, and the console's
	  readout window is the only way out of them.

	  It halts the machine while it reads and starts it again
	  afterwards, so it is run when somebody wants to look. It is
	  not a daemon and has no init script.
```

## boards/arty-z7-20/linux/buildroot/package/cadr-serial/Config.in
```kconfig
# SPDX-FileCopyrightText: 2026 Mete Balci
# SPDX-License-Identifier: AGPL-3.0-or-later
config BR2_PACKAGE_CADR_SERIAL
	bool "cadr-serial"
	select BR2_PACKAGE_CADR_COMMON
	help
	  The CADR's serial line on a TCP socket, as muir's --serial
	  does.  The Signetics 2651 at IOBSER 0A12 is in the fabric and
	  keeps its own time; this program is the other end of the
	  RS-232 cable on J9.  A connection is the device plugging in,
	  which raises DSR, DCD and CTS, and hanging up drops them.

	  ONE DEVICE AT A TIME.  One thing is on the far end of a
	  null-modem cable, so a second connection is closed as it
	  arrives rather than shouting over the first.

	  NO RATE IS CHOSEN HERE.  The rate and the character frame are
	  whatever the machine has programmed into the 2651, and the far
	  end of a null-modem cable has no say in either.

	  It has an init script, as cadr-terminal does and unlike
	  cadr-console: somebody attaches when they want the line, and
	  nothing is on the bus while nobody is connected.
```

## boards/arty-z7-20/linux/buildroot/package/cadr-terminal/Config.in
```kconfig
# SPDX-FileCopyrightText: 2026 Mete Balci
# SPDX-License-Identifier: AGPL-3.0-or-later
config BR2_PACKAGE_CADR_TERMINAL
	bool "cadr-terminal"
	select BR2_PACKAGE_CADR_COMMON
	help
	  The screen, the keyboard and the mouse: the program on the
	  processing system that shows the CADR's display to a VNC viewer
	  and carries the viewer's keys and pointer back to the machine.
	  The display board keeps no frame buffer in the fabric --- the
	  picture is written into the display's own region of DDR --- so
	  this maps that region and serves it over RFB.

	  A key becomes one of MIT's own key positions through muir's own
	  mapping, and a pointer becomes counts on the mouse's quadrature
	  lines, both through the I/O board's cables on M_AXI_GP0.  On a
	  bitstream without those cables, and under --no-input, the screen
	  is served read-only and a viewer's input is counted and dropped.

	  It has an init script, as cadr-disk-pack does and unlike
	  cadr-console: a viewer connects when somebody wants to look, and
	  nothing is on the bus while nobody does.
```

## boards/arty-z7-20/linux/buildroot/package/cadr-usb-input/Config.in
```kconfig
# SPDX-FileCopyrightText: 2026 Mete Balci
# SPDX-License-Identifier: AGPL-3.0-or-later
config BR2_PACKAGE_CADR_USB_INPUT
	bool "cadr-usb-input"
	select BR2_PACKAGE_CADR_COMMON
	select BR2_PACKAGE_CADR_TERMINAL
	help
	  A USB keyboard and mouse plugged into the board, carried to the
	  CADR's own keyboard and mouse.  With it the machine can be used
	  at the board rather than only through a viewer on another
	  machine over the network.

	  It reads /dev/input/event* and sends keysyms and mouse movement
	  to cadr-terminal over a local socket; that program writes the
	  I/O board's registers.  There is one queue behind those
	  registers and the rate at which words may be handed over is a
	  rule about the machine, so one program paces them and everything
	  else is a source --- which is how the reference emulator is
	  arranged too, with one keyboard and up to eight viewers pushing
	  into it.  docs/usb-input.md has the decision.

	  It selects cadr-terminal for that reason: without it there is
	  nothing to send to.  It maps no memory and reaches no port of
	  its own.

	  It has an init script, S88, after the terminal's S85.
```

## boards/arty-z7-20/linux/buildroot/package/muir/Config.in
```kconfig
# SPDX-FileCopyrightText: 2026 Mete Balci
# SPDX-License-Identifier: AGPL-3.0-or-later
config BR2_PACKAGE_MUIR
	bool "muir"
	depends on BR2_PACKAGE_HOST_RUSTC_TARGET_ARCH_SUPPORTS
	select BR2_PACKAGE_HOST_RUSTC
	help
	  muir itself, on the board's own Arm cores, beside the CADR in
	  the fabric.  It is built from muir's own source at the commit
	  muir.commit pins, so the board runs the muir this repository is
	  held to.  No binary is carried in this repository.

	  It is here to be the debugger.  MIT debugged a CADR with a
	  second CADR over the debug cable, running CC.  This fabric has
	  the debuggee end of that cable, and muir on the Arm cores is
	  the machine at the other end of it.  It reaches the fabric
	  through a register window over /dev/mem rather than over a
	  wire.

	  Every other program in this tree has an init script and this
	  one has none.  muir is started by hand when it is wanted.  The
	  reason is the cable and not the cost: a debugger that dies
	  mid-request leaves the debuggee's own bus cycle waiting.
	  Running muir costs the fabric CADR nothing, measured with both
	  cores saturated and the machine's rate read off the fabric's
	  own tick counter.

	  /root/.muirrc is a symlink to muirrc on the pack partition, so
	  that the debugger is the word `muir` and its settings survive a
	  reboot.  The root filesystem is a RAM disk unpacked at every
	  boot, so an edit made to a file in it is lost.

comment "muir needs a toolchain the Rust compiler supports"
	depends on !BR2_PACKAGE_HOST_RUSTC_TARGET_ARCH_SUPPORTS
```

## boards/arty-z7-20/linux/buildroot/package/ozd/Config.in
```kconfig
# SPDX-FileCopyrightText: 2026 Mete Balci
# SPDX-License-Identifier: AGPL-3.0-or-later
config BR2_PACKAGE_OZD
	bool "ozd"
	depends on BR2_PACKAGE_HOST_RUSTC_TARGET_ARCH_SUPPORTS
	select BR2_PACKAGE_HOST_RUSTC
	help
	  ozd on the board's own processing system: the associated
	  machine of the CADR in the fabric.  It answers the band's
	  file host and its time host, and it serves the host table.

	  A CADR has no file or time server in it, and neither has the
	  fabric and neither has cadr-chaosnet.  The host the band calls
	  is a machine on the network, and until now that machine had to
	  be somewhere else.  This package puts one on the board, so a
	  board with a card and no network is a whole site by itself:
	  the machine boots, asks for the time, is answered, and reaches
	  its files.

	  It is on unless the card turns it off with --no-ozd, and it
	  listens on the loopback and nowhere else.  ozd authenticates
	  nobody: any host that can reach its socket may read every root
	  and write every root that is not read-only.  The loopback is
	  therefore a decision and not a default, and a board that is to
	  serve a second machine has to be told to.

	  It is built from ozd's own source at the commit ozd.commit
	  pins, the way muir is, so no binary is carried in this
	  repository and ozd is never patched here.

comment "ozd needs a toolchain the Rust compiler supports"
	depends on !BR2_PACKAGE_HOST_RUSTC_TARGET_ARCH_SUPPORTS
```

## boards/arty-z7-20/linux/buildroot/package/quux-ethernet-device/Config.in
```kconfig
# SPDX-FileCopyrightText: 2026 Mete Balci
# SPDX-License-Identifier: AGPL-3.0-or-later
config BR2_PACKAGE_QUUX_ETHERNET_DEVICE
	bool "quux-ethernet-device"
	select BR2_PACKAGE_CADR_COMMON
	help
	  QUUX's Ethernet device, the Linux side: the program that
	  sends the Ethernet frames QUUX's transmit ring names to the
	  tap quux0 and delivers the tap's into QUUX's receive ring,
	  filling in and checking the IPv4, TCP, UDP and ICMP
	  checksums, through the Ethernet device's page in the fabric.

	  QUUX revision 16 only: its init script makes the tap and
	  starts it when the card's fpgarc says --machine quux.  The
	  kernel needs CONFIG_TUN and BusyBox its tunctl.
```

## boards/arty-z7-20/linux/buildroot/package/quux-file-device/Config.in
```kconfig
# SPDX-FileCopyrightText: 2026 Mete Balci
# SPDX-License-Identifier: AGPL-3.0-or-later
config BR2_PACKAGE_QUUX_FILE_DEVICE
	bool "quux-file-device"
	select BR2_PACKAGE_CADR_COMMON
	help
	  QUUX's file device, the Linux side: the program that serves
	  the card's folders to QUUX as the pathname host HOST.  QUUX
	  writes commands into a ring in its main memory and this reads
	  them out of DDR, does each on a Linux folder, and writes the
	  answer back, through the file device's page in the fabric.
	  It also keeps QUUX's real-time clock.

	  QUUX only: its init script starts it when the card's fpgarc
	  says --machine quux, and not otherwise.
```

## linux/buildroot/Config.in
```kconfig
# SPDX-FileCopyrightText: 2026 Mete Balci
# SPDX-License-Identifier: AGPL-3.0-or-later
source "$BR2_EXTERNAL_CADR_PATH/package/cadr-common/Config.in"
source "$BR2_EXTERNAL_CADR_PATH/package/cadr-console/Config.in"
source "$BR2_EXTERNAL_CADR_PATH/package/cadr-disk-pack/Config.in"
source "$BR2_EXTERNAL_CADR_PATH/package/cadr-terminal/Config.in"
```

## linux/buildroot/package/cadr-console/Config.in
```kconfig
# SPDX-FileCopyrightText: 2026 Mete Balci
# SPDX-License-Identifier: AGPL-3.0-or-later
config BR2_PACKAGE_CADR_CONSOLE
	bool "cadr-console"
	select BR2_PACKAGE_CADR_COMMON
	help
	  The console: the program on the processing system that halts
	  the CADR, reads its sixteen diagnostic registers and starts it
	  again, over M_AXI_GP1.  Its vocabulary is muir's spy module's
	  with no translation in between.

	  It is INTERACTIVE and has no init script: a console that ran
	  unasked would be a second master on the diagnostic bus for as
	  long as the board was up.
```

## linux/buildroot/package/cadr-disk-pack/Config.in
```kconfig
# SPDX-FileCopyrightText: 2026 Mete Balci
# SPDX-License-Identifier: AGPL-3.0-or-later
config BR2_PACKAGE_CADR_DISK_PACK
	bool "cadr-disk-pack"
	select BR2_PACKAGE_CADR_COMMON
	help
	  The disk pack program: the program on the processing system that serves
	  the CADR's disk from the pack file on the card, with the init
	  script that mounts the card and starts it.  One package per
	  program, decided 10 Sep: the console, the RFB server, the Chaosnet
	  bridge and USB input each get their own beside this one, and what
	  they share goes into a cadr-common package when the second arrives.
	  The second arrived on 10 Sep and cadr-common is that package.
```

## linux/buildroot/package/cadr-tools/Config.in
```kconfig
# SPDX-FileCopyrightText: 2026 Mete Balci
# SPDX-License-Identifier: AGPL-3.0-or-later
config BR2_PACKAGE_CADR_TOOLS
	bool "cadr-tools"
	help
	  The programs that run on the processing system beside the CADR,
	  built from the source directory beside this file.  Today:
	  cadr-pack-feeder, which serves the CADR's disk from the pack
	  file on the card, and the init script that mounts the card and
	  starts it.
```
