// SPDX-FileCopyrightText: 2026 Mete Balci
// SPDX-License-Identifier: GPL-2.0-or-later
/*
 * The DE25-Nano's hard processor system, as Linux and U-Boot see it, with
 * the CADR beside it.
 *
 * ONE FILE FOR BOTH, as the Zynq boards' trees are, and a thin one: it is
 * Altera's own DE25-Nano tree with four things added.  The kernel compiles it
 * from arch/arm64/boot/dts/intel/ and U-Boot from arch/arm/dts/, and in each
 * `#include "socfpga_agilex5_de25_nano.dts"` finds THAT tree's own file ---
 * Altera ships one in its kernel (linux-socfpga, arch/arm64/boot/dts/intel/)
 * and another in its U-Boot (u-boot-socfpga, arch/arm/dts/), and they are
 * not the same file.  Neither is copied here; both are included from the
 * pinned sources.  U-Boot adds socfpga_agilex5_de25_nano_cadr-u-boot.dtsi by
 * name.
 *
 * WHAT IS ADDED:
 *
 *   the model, restated in Altera's own words ("SoCFPGA Agilex5 Terasic
 *     DE25-Nano", both of Altera's trees) so that the card staging can read
 *     which board's tree this is out of this file, as it reads the Zynq
 *     boards' out of theirs;
 *   the CADR's 128 MB at 0xB000_0000, no-map, from cadr-reserved.dtsi, which
 *     says why there and why in both trees;
 *   the USB port as a HOST.  The board's one USB port is the processor's
 *     DWC2 controller behind a USB3320 ULPI PHY at a Type-C connector, and
 *     Terasic's manual calls it "One USB 2.0 host with Type-C USB connector"
 *     and says the port supplies power to a device in host mode (DE25-Nano
 *     user manual, rev B, section 3.8.5).  Altera's kernel tree enables
 *     `usb0` and leaves its mode to the controller, which is on-the-go; a
 *     keyboard and a mouse want a host, so this says so.  U-Boot's tree has
 *     the same label and leaves the controller disabled, so the line does
 *     nothing there.
 *   the ETHERNET PHY'S RECEIVE DELAY.  Altera's tree gives `gmac0`
 *     `phy-mode = "rgmii"` and says beside it that the delays are on the
 *     printed board.  They are not, on the receive side: measured on the
 *     board, with that mode the interface negotiated a gigabit, transmitted,
 *     and received NOTHING AT ALL --- rx_packets zero with rx_errors,
 *     rx_crc_errors and rx_frame_errors all zero too, which is a receiver
 *     that never starts a frame rather than one that breaks the frames it
 *     starts.  The part's own numbers say why: the KSZ9031 carries a built-in
 *     1.2 ns receive delay, and on `rgmii` the kernel's micrel driver writes
 *     the pad skews that CANCEL it (drivers/net/phy/micrel.c, RX_ND and
 *     RX_CLK_ND, "to compensate the internal 1.2ns delay"), leaving the
 *     receive path with no delay at all.  `rgmii-id` leaves the part's delay
 *     in place and adds to it, and with it the same board received frames
 *     immediately and CLEANLY: rx_packets climbing with every receive error
 *     counter still at zero, and a count that rose by four when the build
 *     host sent five address requests.
 *
 *     THE TRANSMIT SIDE WAS A SEPARATE FAULT AND IS NOT ONE NOW.  Measured
 *     before this line reached a card, with the mode poked into the loader's
 *     copy of the tree by hand, the transmit counter advanced by the same
 *     handful whether three frames were asked for or forty, with no errors and
 *     no timeout, which is a ring that is not being reclaimed and which no
 *     skew setting reaches.  Measured again from a card carrying this line,
 *     the board takes an address, answers a ping in half a millisecond, and
 *     carries the machine's own network traffic to a host and back.  So the
 *     stall went with the half-configured interface rather than being a fault
 *     of its own, and `rgmii-id` is right on both sides rather than only on
 *     the receive one.  This was found while looking at something else and has
 *     not been investigated: whoever returns to it should try to reproduce the
 *     stall before believing it is gone.
 *   the QSPI FLASH CONTROLLER TURNED OFF.  The controller is shared between
 *     the processor and the Secure Device Manager, and the manager owns it at
 *     every power-up.  The processor gets it only by asking over the
 *     manager's mailbox, and THE FABRIC IMAGE DECIDES WHETHER THE MANAGER
 *     SAYS YES, through the QSPI Ownership setting the assembler writes into
 *     that image (Hard Processor System Booting User Guide, document 813762,
 *     section 4.12; Hard Processor System Technical Reference Manual,
 *     document 814346, appendix A.2.2).  So Linux can find itself holding a
 *     controller it may not touch, and the Cadence driver's first register
 *     read, in `cqspi_wait_idle` called from `cqspi_probe`, then takes an
 *     external abort.  Measured on this board: a synchronous external abort,
 *     ESR 0x96000010, on the instruction that reads the configuration
 *     register, which kills init; and on the boot after it an asynchronous
 *     SError, ESR 0xbe000011, at the same two functions, which panics the
 *     kernel.  That is what this board does when it is configured from the
 *     image its flash carries as shipped, because that image keeps the
 *     controller for the manager.
 *
 *     TURNING THE NODE OFF IS ALTERA'S OWN REMEDY for exactly this case:
 *     document 813762, Table 17, gives `status = "disabled"` on this node as
 *     the Linux half of what to build when the manager keeps the controller.
 *     IT COSTS NOTHING HERE.  A board that DOES own the controller has no
 *     flash device either, because the part answers a JEDEC identification
 *     the kernel does not recognize, so `/proc/mtd` is empty and `/dev/mtd*`
 *     is absent on both kinds of boot alike; and no init script, no program
 *     and no partition on the card reads the flash.  What is given up is
 *     reaching the flash from Linux at all, which a remote system update
 *     would want and nothing on this board does.
 *
 * NOTHING OF THE FABRIC IS DESCRIBED.  As on the Zynq boards the programs
 * reach the faces through /dev/mem, so there is no node for them, and the
 * fabric's own bridges are U-Boot's to open: `cadr_de25.env` loads the fabric
 * and runs `bridge enable` before the kernel starts.
 */

#include "socfpga_agilex5_de25_nano.dts"
#include "cadr-reserved.dtsi"

/ {
	model = "SoCFPGA Agilex5 Terasic DE25-Nano";
};

&usb0 {
	dr_mode = "host";
};

/*
 * The receive delay, which the printed board does not carry: see the header.
 * U-Boot's own DE25-Nano tree has the same label and the same `phy-mode`, so
 * this line lands in both trees, which is what one file for both is for.
 */
&gmac0 {
	phy-mode = "rgmii-id";
};

/*
 * The flash controller the Secure Device Manager may be keeping for itself:
 * see the header.  Nothing here reads the flash, and a board that is allowed
 * to touch the controller loses nothing by this line.
 *
 * THIS LINE REACHES THE KERNEL'S TREE ALONE, which is the one place it is
 * needed, because U-Boot appends `<tree>-u-boot.dtsi` after this file and
 * Altera's `socfpga_agilex5_de25_nano-u-boot.dtsi` sets this same node back to
 * `okay` there.  So the first-stage loader and U-Boot keep the node they have
 * and nothing about the boot changes; U-Boot binds a driver to it only when a
 * command asks for the flash, and none of this board's commands does.
 */
&qspi {
	status = "disabled";
};
