// SPDX-FileCopyrightText: 2026 Mete Balci
// SPDX-License-Identifier: GPL-2.0-or-later
/*
 * What U-Boot adds to QUUX's tree: the board's own additions, and the
 * tree binman packs into QUUX's u-boot.itb pointed at QUUX's.
 * U-Boot includes <tree>-u-boot.dtsi by the name of the tree it compiles, so
 * QUUX's tree gets this file, which includes the CADR tree's.
 */

#include "socfpga_agilex5_de25_nano_cadr-u-boot.dtsi"

#if !defined(CONFIG_SOCFPGA_SECURE_VAB_AUTH)
&fdt_0_blob {
	filename = "arch/arm/dts/socfpga_agilex5_de25_nano_quux13.dtb";
};
#endif
